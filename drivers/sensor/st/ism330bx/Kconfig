## drivers/sensor/st/ism330bx/Kconfig
```kconfig
# ST Microelectronics ISM330BX 6-axis IMU sensor driver

# Copyright (c) 2023 STMicroelectronics
# SPDX-License-Identifier: Apache-2.0

menuconfig ISM330BX
	bool "ISM330BX I2C/SPI accelerometer and gyroscope Chip"
	default y
	depends on DT_HAS_ST_ISM330BX_ENABLED
	depends on ZEPHYR_HAL_ST_MODULE
	select I2C if $(dt_compat_on_bus,$(DT_COMPAT_ST_ISM330BX),i2c)
	select SPI if $(dt_compat_on_bus,$(DT_COMPAT_ST_ISM330BX),spi)
	select HAS_STMEMSC
	select PM_DEVICE
	help
	  Enable driver for ISM330BX accelerometer and gyroscope
	  sensor.

if ISM330BX

module = ISM330BX
module-str = ism330bx
source "subsys/logging/Kconfig.template.log_config"

config USE_STDC_ISM330BX
	bool
	default y

choice ISM330BX_TRIGGER_MODE
	prompt "Trigger mode"
	help
	  Specify the type of triggering to be used by the driver.

config ISM330BX_TRIGGER_NONE
	bool "No trigger"

config ISM330BX_TRIGGER_GLOBAL_THREAD
	bool "Use global thread"
	depends on GPIO
	select ISM330BX_TRIGGER

config ISM330BX_TRIGGER_OWN_THREAD
	bool "Use own thread"
	depends on GPIO
	select ISM330BX_TRIGGER

endchoice

config ISM330BX_TRIGGER
	bool

if ISM330BX_TRIGGER

config ISM330BX_THREAD_PRIORITY
	int "Thread priority"
	depends on ISM330BX_TRIGGER_OWN_THREAD
	default 10
	help
	  Priority of thread used by the driver to handle interrupts.

config ISM330BX_THREAD_STACK_SIZE
	int "Thread stack size"
	depends on ISM330BX_TRIGGER_OWN_THREAD
	default 1024
	help
	  Stack size of thread used by the driver to handle interrupts.

config ISM330BX_6D_ORIENTATION_DETECTION
	bool "6D orientation detection (via interrupt)"
	help
	  Enable 6D orientation detection via interrupt.

config ISM330BX_SIGNIFICANT_MOTION_DETECTION
	bool "Significant motion detection (via interrupt)"
	help
	  Enable 6D orientation detection via interrupt.
config ISM330BX_WAKEUP_DETECTION
	bool "wakeup detection (via interrupt)"
	help
	  Enable Wakeup detection based on acceleration measurements.

endif # ISM330BX_TRIGGER

config ISM330BX_ENABLE_TEMP
	bool "Temperature"
	help
	  Enable/disable temperature



config ISM330BX_SENSORHUB
	bool "I2C sensorhub feature"
	help
	  Enable/disable internal sensorhub. You can enable
	  a maximum of two external sensors (if more than two are enabled
	  the system would enumerate only the first two found)


if ISM330BX_SENSORHUB

config ISM330BX_EXT_LIS2MDL
	bool "LIS2MDL as external sensor"
	default y

config ISM330BX_EXT_LPS22HH
	bool "LPS22HH as external sensor"

config ISM330BX_EXT_HTS221
	bool "HTS221 as external sensor"

config ISM330BX_EXT_LPS22HB
	bool "LPS22HB as external sensor"

config ISM330BX_EXT_LPS22DF
	bool "LPS22DF as external sensor"
	default y

endif # ISM330BX_SENSORHUB


endif # ISM330BX
```

## dts/bindings/sensor/st,ism330bx-common.yaml
```yaml
# Copyright (c) 2023 STMicroelectronics
# SPDX-License-Identifier: Apache-2.0

description: |
  When setting the accel-range, accel-odr, gyro-range, gyro-odr properties in
  a .dts or .dtsi file you may include ism330bx.h and use the macros
  defined there.

  Example:
  #include <zephyr/dt-bindings/sensor/ism330bx.h>

  ism330bx: ism330bx@0 {
    ...

    accel-range = <ISM330BX_DT_FS_8G>;
    accel-odr = <ISM330BX_DT_ODR_AT_60Hz>;
    gyro-range = <ISM330BX_DT_FS_4000DPS>;
    gyro-odr = <ISM330BX_DT_ODR_AT_60Hz>;
  };

include: sensor-device.yaml

properties:
  int1-gpios:
    type: phandle-array
    description: |
      INT1 pin

      This pin defaults to active high when produced by the sensor.
      The property value should ensure the flags properly describe
      the signal that is presented to the driver.

  int2-gpios:
    type: phandle-array
    description: |
      INT2 pin

      This pin defaults to active high when produced by the sensor.
      The property value should ensure the flags properly describe
      the signal that is presented to the driver.

  drdy-pin:
    type: int
    default: 1
    enum:
      - 1 # drdy is generated from INT1
      - 2 # drdy is generated from INT2
    description: |
      Select DRDY pin number (1 or 2).

      This number represents which of the two interrupt pins
      (INT1 or INT2) the drdy line is attached to. This property is not
      mandatory and if not present it defaults to 1 which is the
      configuration at power-up.

  accel-range:
    type: int
    default: 0
    description: |
      Range in g. Default is power-up configuration.

      - 0 # ISM330BX_DT_FS_2G  (0.061 mg/LSB)
      - 1 # ISM330BX_DT_FS_4G  (0.122 mg/LSB)
      - 2 # ISM330BX_DT_FS_8G  (0.244 mg/LSB)
      - 3 # ISM330BX_DT_FS_16G (0.488 mg/LSB)

    enum: [0, 1, 2, 3]

  accel-odr:
    type: int
    default: 0x0
    description: |
      Specify the default accelerometer output data rate expressed in samples per second (Hz).
      The values are taken in accordance to ism330bx_data_rate_t enumerative in hal/st
      module. Please note that this values will not change the operating mode, which will remain
      High Performance (device default)
      Default is power-up configuration.

      - 0x00 # ISM330BX_DT_ODR_OFF
      - 0x01 # ISM330BX_DT_ODR_AT_1Hz875
      - 0x02 # ISM330BX_DT_ODR_AT_7Hz5
      - 0x03 # ISM330BX_DT_ODR_AT_15Hz
      - 0x04 # ISM330BX_DT_ODR_AT_30Hz
      - 0x05 # ISM330BX_DT_ODR_AT_60Hz
      - 0x06 # ISM330BX_DT_ODR_AT_120Hz
      - 0x07 # ISM330BX_DT_ODR_AT_240Hz
      - 0x08 # ISM330BX_DT_ODR_AT_480Hz
      - 0x09 # ISM330BX_DT_ODR_AT_960Hz
      - 0x0a # ISM330BX_DT_ODR_AT_1920Hz
      - 0x0b # ISM330BX_DT_ODR_AT_3840Hz
      - 0x0c # ISM330BX_DT_ODR_AT_7680Hz
      - 0x13 # ISM330BX_DT_ODR_HA01_AT_15Hz625
      - 0x14 # ISM330BX_DT_ODR_HA01_AT_31Hz25
      - 0x15 # ISM330BX_DT_ODR_HA01_AT_62Hz5
      - 0x16 # ISM330BX_DT_ODR_HA01_AT_125Hz
      - 0x17 # ISM330BX_DT_ODR_HA01_AT_250Hz
      - 0x18 # ISM330BX_DT_ODR_HA01_AT_500Hz
      - 0x19 # ISM330BX_DT_ODR_HA01_AT_1000Hz
      - 0x1a # ISM330BX_DT_ODR_HA01_AT_2000Hz
      - 0x1b # ISM330BX_DT_ODR_HA01_AT_4000Hz
      - 0x1c # ISM330BX_DT_ODR_HA01_AT_8000Hz
      - 0x23 # ISM330BX_DT_ODR_HA02_AT_12Hz5
      - 0x24 # ISM330BX_DT_ODR_HA02_AT_25Hz
      - 0x25 # ISM330BX_DT_ODR_HA02_AT_50Hz
      - 0x26 # ISM330BX_DT_ODR_HA02_AT_100Hz
      - 0x27 # ISM330BX_DT_ODR_HA02_AT_200Hz
      - 0x28 # ISM330BX_DT_ODR_HA02_AT_400Hz
      - 0x29 # ISM330BX_DT_ODR_HA02_AT_800Hz
      - 0x2a # ISM330BX_DT_ODR_HA02_AT_1600Hz
      - 0x2b # ISM330BX_DT_ODR_HA02_AT_3200Hz
      - 0x2c # ISM330BX_DT_ODR_HA02_AT_6400Hz

    enum:
      [
        0x00,
        0x01,
        0x02,
        0x03,
        0x04,
        0x05,
        0x06,
        0x07,
        0x08,
        0x09,
        0x0a,
        0x0b,
        0x0c,
        0x13,
        0x14,
        0x15,
        0x16,
        0x17,
        0x18,
        0x19,
        0x1a,
        0x1b,
        0x1c,
        0x23,
        0x24,
        0x25,
        0x26,
        0x27,
        0x28,
        0x29,
        0x2a,
        0x2b,
        0x2c,
      ]

  gyro-range:
    type: int
    default: 0
    description: |
      Range in dps. Default is power-up configuration.

      - 0x0 # ISM330BX_DT_FS_125DPS  (4.375 mdps/LSB)
      - 0x1 # ISM330BX_DT_FS_250DPS  (8.75 mdps/LSB)
      - 0x2 # ISM330BX_DT_FS_500DPS  (17.50 mdps/LSB)
      - 0x3 # ISM330BX_DT_FS_1000DPS (35 mdps/LSB)
      - 0x4 # ISM330BX_DT_FS_2000DPS (70 mdps/LSB)
      - 0xc # ISM330BX_DT_FS_4000DPS (140 mdps/LSB)

    enum: [0x0, 0x1, 0x2, 0x3, 0x4, 0xc]

  gyro-odr:
    type: int
    default: 0x0
    description: |
      Specify the default gyro output data rate expressed in samples per second (Hz).
      The values are taken in accordance to ism330bx_data_rate_t enumerative in hal/st
      module. Please note that these values will not change the operating mode, which will remain
      High Performance (device default). Moreover, the values here which will be selected in the
      DT are the only way to specify the odr accuracy even at runtime with
      SENSOR_ATTR_SAMPLING_FREQUENCY.
      Default is power-up configuration.

      - 0x00 # ISM330BX_DT_ODR_OFF
      - 0x01 # ISM330BX_DT_ODR_AT_1Hz875
      - 0x02 # ISM330BX_DT_ODR_AT_7Hz5
      - 0x03 # ISM330BX_DT_ODR_AT_15Hz
      - 0x04 # ISM330BX_DT_ODR_AT_30Hz
      - 0x05 # ISM330BX_DT_ODR_AT_60Hz
      - 0x06 # ISM330BX_DT_ODR_AT_120Hz
      - 0x07 # ISM330BX_DT_ODR_AT_240Hz
      - 0x08 # ISM330BX_DT_ODR_AT_480Hz
      - 0x09 # ISM330BX_DT_ODR_AT_960Hz
      - 0x0a # ISM330BX_DT_ODR_AT_1920Hz
      - 0x0b # ISM330BX_DT_ODR_AT_3840Hz
      - 0x0c # ISM330BX_DT_ODR_AT_7680Hz
      - 0x13 # ISM330BX_DT_ODR_HA01_AT_15Hz625
      - 0x14 # ISM330BX_DT_ODR_HA01_AT_31Hz25
      - 0x15 # ISM330BX_DT_ODR_HA01_AT_62Hz5
      - 0x16 # ISM330BX_DT_ODR_HA01_AT_125Hz
      - 0x17 # ISM330BX_DT_ODR_HA01_AT_250Hz
      - 0x18 # ISM330BX_DT_ODR_HA01_AT_500Hz
      - 0x19 # ISM330BX_DT_ODR_HA01_AT_1000Hz
      - 0x1a # ISM330BX_DT_ODR_HA01_AT_2000Hz
      - 0x1b # ISM330BX_DT_ODR_HA01_AT_4000Hz
      - 0x1c # ISM330BX_DT_ODR_HA01_AT_8000Hz
      - 0x23 # ISM330BX_DT_ODR_HA02_AT_12Hz5
      - 0x24 # ISM330BX_DT_ODR_HA02_AT_25Hz
      - 0x25 # ISM330BX_DT_ODR_HA02_AT_50Hz
      - 0x26 # ISM330BX_DT_ODR_HA02_AT_100Hz
      - 0x27 # ISM330BX_DT_ODR_HA02_AT_200Hz
      - 0x28 # ISM330BX_DT_ODR_HA02_AT_400Hz
      - 0x29 # ISM330BX_DT_ODR_HA02_AT_800Hz
      - 0x2a # ISM330BX_DT_ODR_HA02_AT_1600Hz
      - 0x2b # ISM330BX_DT_ODR_HA02_AT_3200Hz
      - 0x2c # ISM330BX_DT_ODR_HA02_AT_6400Hz

    enum:
      [
        0x00,
        0x01,
        0x02,
        0x03,
        0x04,
        0x05,
        0x06,
        0x07,
        0x08,
        0x09,
        0x0a,
        0x0b,
        0x0c,
        0x13,
        0x14,
        0x15,
        0x16,
        0x17,
        0x18,
        0x19,
        0x1a,
        0x1b,
        0x1c,
        0x23,
        0x24,
        0x25,
        0x26,
        0x27,
        0x28,
        0x29,
        0x2a,
        0x2b,
        0x2c,
      ]

  drdy-pulsed:
    type: boolean
    description: |
      Selects the pulsed mode for data-ready interrupt when enabled,
      and the latched mode when disabled.
```

## dts/bindings/sensor/st,ism330bx-i2c.yaml
```yaml
# Copyright (c) 2020 STMicroelectronics
# SPDX-License-Identifier: Apache-2.0

description: |
  STMicroelectronics ISM330BX 6-axis IMU (Inertial Measurement Unit) sensor
  accessed through I2C bus

compatible: "st,ism330bx"

include: ["i2c-device.yaml", "st,ism330bx-common.yaml"]
```

## dts/bindings/sensor/st,ism330bx-spi.yaml
```yaml
# Copyright (c) 2023 STMicroelectronics
# SPDX-License-Identifier: Apache-2.0

description: |
  STMicroelectronics ISM330BX 6-axis IMU (Inertial Measurement Unit) sensor
  accessed through SPI bus

compatible: "st,ism330bx"

include: ["spi-device.yaml", "st,ism330bx-common.yaml"]
```
